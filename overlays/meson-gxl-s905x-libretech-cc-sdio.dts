/*
 * Copyright (c) 2017 BayLibre, SAS.
 * Author: Neil Armstrong <narmstrong@baylibre.com>
 *
 * SPDX-License-Identifier: (GPL-2.0+ OR MIT)
 */

/*
 * Overlay aimed to enable SDIO on Header 7J1 :
 * Pins 22;26;36;38 (D0-D3), 35 (IRQ), 37 (CMD), 40 (CLK)
 */

/dts-v1/;
/plugin/;

/ {
	compatible = "libretech,cc", "amlogic,s905x", "amlogic,meson-gxl";

	fragment@0 {
		target = <&sd_emmc_a>;
		
		__overlay__ {
			status = "okay";
			pinctrl-0 = <&sdio_pins>;
			pinctrl-names = "default";
		};
	};
};
